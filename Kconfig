## Kconfig
```kconfig
config ELPEKENIN_LAYER_CALLBACK
    bool
    default y
    depends on DT_HAS_ELPEKENIN_LAYER_CALLBACK_ENABLED

config ELPEKENIN_LOCK_INDICATOR
    bool
    default y
    depends on DT_HAS_ELPEKENIN_LOCK_INDICATOR_ENABLED

rsource "Kconfig.behaviors"
```

## Kconfig.behaviors
```kconfig
config ELPEKENIN_BEHAVIOR_GPIO
    bool
    default y
    depends on DT_HAS_ELPEKENIN_BEHAVIOR_GPIO_ENABLED

config ELPEKENIN_BEHAVIOR_DEFAULT_LAYER
    bool
    default y
    depends on DT_HAS_ELPEKENIN_BEHAVIOR_DEFAULT_LAYER_ENABLED && SETTINGS
```

## dts/bindings/behaviors/elpekenin,behavior-default-layer.yaml
```yaml
# Copyright (c) 2024 The ZMK Contributors
# SPDX-License-Identifier: MIT

description: Behavior to persistently change layer

compatible: "elpekenin,behavior-default-layer"

include: one_param.yaml
```

## dts/bindings/behaviors/elpekenin,behavior-gpio.yaml
```yaml
# Copyright (c) 2024 The ZMK Contributors
# SPDX-License-Identifier: MIT

description: Behavior to control GPIOs (LEDs)

compatible: "elpekenin,behavior-gpio"

include: two_param.yaml
```

## dts/bindings/elpekenin,layer-callback.yaml
```yaml
# Copyright (c) 2024 The ZMK Contributors
# SPDX-License-Identifier: MIT

description: Tap (press and release) behavior(s) when a layer is (de)activated

compatible: "elpekenin,layer-callback"


child-binding:
  description: "Configuration for an event on a layer"

  properties:
    layer:
      type: int
      required: true
    event:
      type: string
      required: true
      enum:
        - "on-activation"
        - "on-deactivation"
    bindings:
      type: phandle-array
      required: true
```

## dts/bindings/elpekenin,lock-indicator.yaml
```yaml
# Copyright (c) 2024 The ZMK Contributors
# SPDX-License-Identifier: MIT

description: Turn LEDs on/off based on HID indicators' state

compatible: "elpekenin,lock-indicator"

child-binding:
  description: "Configuration for an indicator"

  properties:
    mask:
      type: int
      required: true
    led:
      type: phandle
      required: true
```
